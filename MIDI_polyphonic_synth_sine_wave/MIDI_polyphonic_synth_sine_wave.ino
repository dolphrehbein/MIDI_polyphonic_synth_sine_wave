//Uses the Arduino MIDI library
#include <MIDI.h>
MIDI_CREATE_INSTANCE(HardwareSerial, Serial1, MIDI1);
//LUT for arctangent compression (4KB)
const byte PROGMEM compressionTable[] = {1, 1, 1, 1, 1, 1, 1, 1, 1, 1, 1, 1, 1,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 255, 255};
//LUT for sine wave (1KB)
const char SineWave[1024] = {0,1,2,2,3,4,5,5,6,7,8,9,10,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0,0};
//LUT for step in for each MIDI note (256B)
const short stepTable[] = {16, 17, 18, 19, 21, 22, 23, 25, 26, 28, 29, 31, 33,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 25088, 26580};
//Note class is used to handle each of the 16 possible notes independently for Polyphony.
class Note
{
  public:
    //MIDI note value
    unsigned char n;
    //State = -1 note off. State = 1 note on
    char state;
    //MIDI velocity value
    unsigned char velocity;
    //index of the quarter sine wave
    volatile unsigned short index = 0;
    //step size of the note n through the quarter sine wave.
    unsigned short Step = 0;
    
    //initialize all notes off.
    Note()
    {
      state = -1;
    }
    //Sets the step value for the note and changes the state to on.
    void on(unsigned char n, unsigned char v)
    {
      state = -1;
      this->n = n;
      velocity = v;
      Step = stepTable[n];
      state = 1;
    }

    void off()
    {
      state = -1;
    }
    //Calculates the sample for each independent note before mixing them in the ISR.
    short mix()
    {
      //sample ranges from -127 to +127
      volatile short sample = 0;
      
      //index is shifted to the right 6 times to reduce the size of the sine table.
      unsigned short highIndex = index >> 6;
      //Multiplied by the velocity and shifted to the right 7 bits to get the correct amplitude.
      sample = (SineWave[highIndex] * velocity) >> 7;
      //Increment the index and the quadrant and check for overflows.
      index += Step;
      return sample;
    }
};

//Initialize note map for 128 possible notes and 16 possible channels.
//It stores -1 if the [channel][note] is off and the index in the array notes if it is on.
char noteMap[16][128];

//Allow 16 Notes to be played at once. Value can be changed.
#define MAX_NOTES 16
//create array of 16 members of the Note class. These are the notes that are actively being played.
Note notes [MAX_NOTES];

//Occurs when key is realeased.
void noteOff(byte ch, byte n, byte v)
{
  //Check if the note is on. If it is turn it off and set its index in the noteMap to -1.
  if (noteMap[ch][n] >= 0)
  {
    notes[noteMap[ch][n]].off();
    noteMap[ch][n] = -1;
  }
}
//Occurs when key is pressed.
void noteOn(byte ch, byte n, byte v)
{
  //Many MIDI controllers send the Note on command (0x80) with velocity 0. Here we check for that.
  if (!v)
  {
    noteOff(ch, n, 0);
    return;
  }
  //If the note is on keep its index in the notes array and update its velocity.
  if (noteMap[ch][n] >= 0)
    notes[noteMap[ch][n]].on(n, v);
  //If the note is on look for a spot in the note array that is off and replace it. Then turn the note on.
  else
    for (char i = 0; 1 < MAX_NOTES; i++)
      if (notes[i].state == -1)
      {
        noteMap[ch][n] = i;
        notes[i].on(n, v);
        break;
      }
}


void setup() {
  //Start MIDI and read from all channels.
  MIDI1.begin(MIDI_CHANNEL_OMNI);
  //Note on is called when a note is presseed (0x80)
  MIDI1.setHandleNoteOn(noteOn);
  //Note off is called when a note is released (0x90)
  MIDI1.setHandleNoteOff(noteOff);

  //Set port C to output (pin 30-37 for Arduino Mega)
  DDRC = 255;

  //Put timer 5 in clear timer on compare mode. See Atmel atmega 2560 Datasheet.
  TCCR5A = 0;
  TCCR5B = (1 << WGM52) | (1 << CS50);
  //Set the compare value to the clockspeed/sample rate. 
  //Sample rate was chosen to be half the LUT size to avoid rounding errors when calculating step table.
  //This will cause the interrupt to occur at the sample rate.
  OCR5A = 16000000 /32768;
  //Set the mask bit for the interrupt to 1 to enable the timer
  TIMSK5 = (1 << OCIE5A);
  
  

  //Initialize note map with -1 for every index.
  for (char j = 0; j < 16; j++)
    for (char i = 0; i < 127; i++)
      noteMap[j][i] = -1;
}

//Interrupts and runs every OCR5A cycles
ISR(TIMER5_COMPA_vect)
{
  volatile short sample = 0;
  for (unsigned char i = 0; i < MAX_NOTES; i++)
    if (notes[i].state >= 0)
      sample += notes[i].mix();
  //Put the sample through the compression table.
  //2048 is the minimum value so we shift up by it.
  //Samples outputted from the table into port C range from 0 to 255.
  PORTC = pgm_read_byte(&compressionTable[sample+2048]);
}

void loop() {
  MIDI1.read();
}
